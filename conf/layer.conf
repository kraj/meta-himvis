## conf/layer.conf
```bitbake
# We might have a conf and classes directory, append to BBPATH
BBPATH .= ":${LAYERDIR}"

# We have a recipes directory, add to BBFILES
BBFILES += "${LAYERDIR}/recipes*/*/*.bb ${LAYERDIR}/recipes*/*/*.bbappend"

BBFILE_COLLECTIONS += "meta-himvis"
BBFILE_PATTERN_meta-himvis := "^${LAYERDIR}/"
BBFILE_PRIORITY_meta-himvis = "10"
LAYERSERIES_COMPAT_meta-himvis = "sumo"
```
